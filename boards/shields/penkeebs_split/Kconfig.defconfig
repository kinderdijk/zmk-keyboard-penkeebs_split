## boards/shields/penkeebs_split/Kconfig.defconfig
```kconfig
if SHIELD_PENKEEBS_SPLIT_LEFT
# Name must be under 16 characters
config ZMK_KEYBOARD_NAME
    default "My Keyboard"

config ZMK_SPLIT_BLE_ROLE_CENTRAL
    default y
endif

if SHIELD_PENKEEBS_SPLIT_RIGHT
config ZMK_SPLIT_BLE_ROLE_CENTRAL
    default n
endif

if SHIELD_PENKEEBS_SPLIT_LEFT || SHIELD_PENKEEBS_SPLIT_RIGHT
config ZMK_SPLIT
    default y
endif
```

## boards/shields/penkeebs_split/Kconfig.shield
```kconfig
# No whitespace after the comma or in your keyboard name!
config SHIELD_PENKEEBS_SPLIT_LEFT
    def_bool $(shields_list_contains,penkeebs_split_left)

config SHIELD_PENKEEBS_SPLIT_RIGHT
    def_bool $(shields_list_contains,penkeebs_split_right)
```
